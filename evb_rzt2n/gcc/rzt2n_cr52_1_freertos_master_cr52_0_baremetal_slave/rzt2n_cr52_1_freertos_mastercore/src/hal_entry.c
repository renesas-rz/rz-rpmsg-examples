#include "hal_data.h"

FSP_CPP_HEADER
void R_BSP_WarmStart(bsp_warm_start_event_t event)
BSP_PLACE_IN_SECTION(".warm_start");
BSP_ATTRIBUTE_STACKLESS void R_BSP_WarmStart_StackLess(void)
BSP_PLACE_IN_SECTION(".warm_start");

FSP_CPP_FOOTER

#define IOPORT_CFG_NAME1    g_bsp_pin_cfg1

#define DDR_ADXC0_MIRROR0_ADDRESS    (0x200000000)
#define DDR_ADXC0_MIRROR1_ADDRESS    (0x220000000)
#define DDR_TRAINING_SIZE            (0x0000003F)

extern const ioport_cfg_t IOPORT_CFG_NAME1;

/***********************************************************************************************************************
 * Private function prototypes
 **********************************************************************************************************************/
#if BSP_FEATURE_DDR_SUPPORTED
 #if (1 == BSP_CFG_DDR_INIT_ENABLE)
static void ddr_zero_init(void);

 #endif
#endif

/*******************************************************************************************************************//**
 * main() is generated by the FSP Configuration editor and is used to generate threads if an RTOS is used.  This function
 * is called by main() when no RTOS is used.
 **********************************************************************************************************************/
void hal_entry (void)
{
    /* TODO: add your own code here */
}

/*******************************************************************************************************************//**
 * DDR Zero initial settings
 *
 **********************************************************************************************************************/
#if BSP_FEATURE_DDR_SUPPORTED
 #if (1 == BSP_CFG_DDR_INIT_ENABLE)
static void ddr_zero_init (void)
{
    uint32_t addr_space = 32;
    uint64_t start_addr = (DDR_ADXC0_MIRROR0_ADDRESS + DDR_TRAINING_SIZE);

    *(volatile uint32_t *) (R_DDRSS_BASE + 0x0374) |= (1U << 16);

    *(volatile uint32_t *) (R_DDRSS_BASE + 0x0358) = (start_addr & 0xFFFFFFFF);
    *(volatile uint32_t *) (R_DDRSS_BASE + 0x0350) = (addr_space & 0x3F) << 24;
    *(volatile uint32_t *) (R_DDRSS_BASE + 0x0354) = 1;
    *(volatile uint32_t *) (R_DDRSS_BASE + 0x0360) = 0b100;
    *(volatile uint32_t *) (R_DDRSS_BASE + 0x0364) = 0x00000000;
    *(volatile uint32_t *) (R_DDRSS_BASE + 0x0368) = 0x00000000;

    R_BSP_SoftwareDelay(1, BSP_DELAY_UNITS_MICROSECONDS);

    *(volatile uint32_t *) (R_DDRSS_BASE + 0x0350) |= (1U << 8);
    while (((*(volatile uint32_t *) (R_DDRSS_BASE + 0x0508)) & 0x01) != 0x01)
    {
        *(volatile uint32_t *) (R_DDRSS_BASE + 0x0350) &= ~(1u << 8);
    }

    *(volatile uint32_t *) (R_DDRSS_BASE + 0x052C) = 0xFF;
    *(volatile uint32_t *) (R_DDRSS_BASE + 0x0514) = 0x000001CF;

    while (*(volatile uint32_t *) (R_DDRSS_BASE + 0x0508) & 0x01)
    {
        while (*(volatile uint32_t *) (R_DDRSS_BASE + 0x04F0))
        {
            *(volatile uint32_t *) (R_DDRSS_BASE + 0x0374) &= ~(1U << 16);
        }
    }

    R_BSP_SoftwareDelay(1, BSP_DELAY_UNITS_MICROSECONDS);
}

 #endif
#endif

/*******************************************************************************************************************//**
 * This function is called at various points during the startup process.  This implementation uses the event that is
 * called right before main() to set up the pins.
 *
 * @param[in]  event    Where at in the start up process the code is currently at
 **********************************************************************************************************************/
void R_BSP_WarmStart (bsp_warm_start_event_t event)
{
    if (BSP_WARM_START_RESET == event)
    {
        /* Pre clock initialization */
    }

    if (BSP_WARM_START_POST_C == event)
    {
        /* C runtime environment and system clocks are setup. */

#if BSP_FEATURE_DDR_SUPPORTED
 #if (1 == BSP_CFG_DDR_INIT_ENABLE)

        /* Initialize the DDR settings. */
        bsp_ddr_init();
        ddr_zero_init();
        R_BSP_CacheInvalidateAll();
 #endif
#endif

        if (NULL != g_bsp_pin_cfg1.p_extend)
        {
            /* Configure pins. */
            R_IOPORT_Open(&IOPORT_CFG_CTRL, &IOPORT_CFG_NAME1);
        }
    }
}

/*******************************************************************************************************************//**
 * This function is called without a stack at the very beginning of the startup process.
 * All instructions must be written in inline assembly.
 **********************************************************************************************************************/
BSP_ATTRIBUTE_STACKLESS void R_BSP_WarmStart_StackLess (void)
{
    /* The very beginning of the startup process. */

    /* Do not delete. Required to return to system_init. */
#if (0 == BSP_LP64_SUPPORT)
    __asm volatile ("BX lr");
#else
    __asm volatile ("BR lr");
#endif
}
