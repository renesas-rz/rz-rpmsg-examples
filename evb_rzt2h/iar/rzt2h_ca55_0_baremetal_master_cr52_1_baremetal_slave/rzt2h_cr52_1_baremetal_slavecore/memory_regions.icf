
            /* generated memory regions file - do not edit */
                            define symbol ATCM_CR52_1_START = 0x00000000;
                define symbol ATCM_CR52_1_LENGTH = 0x80000;
                define symbol BTCM_CR52_1_START = 0x00100000;
                define symbol BTCM_CR52_1_LENGTH = 0x10000;
                define symbol SYSTEM_RAM_START = 0x1004BDA8;
                define symbol SYSTEM_RAM_LENGTH = 0x1B4258;
                define symbol xSPI0_CS0_SPACE_START = 0x40000000;
                define symbol xSPI0_CS0_SPACE_LENGTH = 0x8000000;
                define symbol xSPI0_CS1_SPACE_START = 0x48000000;
                define symbol xSPI0_CS1_SPACE_LENGTH = 0x8000000;
                define symbol xSPI1_CS0_SPACE_START = 0x50000000;
                define symbol xSPI1_CS0_SPACE_LENGTH = 0x8000000;
                define symbol xSPI1_CS1_SPACE_START = 0x58000000;
                define symbol xSPI1_CS1_SPACE_LENGTH = 0x8000000;
                define symbol CS0_SPACE_START = 0x70000000;
                define symbol CS0_SPACE_LENGTH = 0x4000000;
                define symbol CS2_SPACE_START = 0x74000000;
                define symbol CS2_SPACE_LENGTH = 0x4000000;
                define symbol CS3_SPACE_START = 0x78000000;
                define symbol CS3_SPACE_LENGTH = 0x4000000;
                define symbol CS5_SPACE_START = 0x7C000000;
                define symbol CS5_SPACE_LENGTH = 0x4000000;
                define symbol PCIE0_MIRROR_START = 0xA0000000;
                define symbol PCIE0_MIRROR_LENGTH = 0x10000000;
                define symbol PCIE1_MIRROR_START = 0xB0000000;
                define symbol PCIE1_MIRROR_LENGTH = 0x10000000;
                define symbol DDR_MIRROR0_START = 0xC0000000;
                define symbol DDR_MIRROR0_LENGTH = 0x20000000;
                define symbol DDR_MIRROR1_START = 0xE0000000;
                define symbol DDR_MIRROR1_LENGTH = 0x20000000;
                define symbol NONCACHE_START = 0x10180000;
                define symbol NONCACHE_LENGTH = 0x80000;
                define symbol eSD_eMMC_SPACE_START = 0x88000000;
                define symbol eSD_eMMC_SPACE_LENGTH = 0xC000000;
                    define symbol SECONDARY = 0x00000001;
                define symbol CR52_1 = 1;
