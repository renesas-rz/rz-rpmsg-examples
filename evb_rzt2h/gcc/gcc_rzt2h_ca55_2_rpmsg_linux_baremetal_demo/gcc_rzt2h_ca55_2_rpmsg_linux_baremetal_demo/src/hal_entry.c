#include "hal_data.h"
#include "bsp_api.h"
#include "RM_OpenAMP_App/platform_info.h"
#include "RM_OpenAMP_App/rsc_table.h"
#include "openamp/virtio.h"
#include "openamp/open_amp.h"

FSP_CPP_HEADER
void R_BSP_WarmStart(bsp_warm_start_event_t event)
BSP_PLACE_IN_SECTION(".warm_start");
BSP_ATTRIBUTE_STACKLESS void R_BSP_WarmStart_StackLess(void)
BSP_PLACE_IN_SECTION(".warm_start");

FSP_CPP_FOOTER

#define RECONNECT_FLG    (1)           /* 1:reconnect after exit, 0:disconnect after exit */
#define RECONNECT_DLY    (10000u)

extern int  init_system(void);
extern int  app(struct rpmsg_device * rdev, void * platform, unsigned long svcno);
extern void cleanup_system(void);

/*******************************************************************************************************************//**
 * main() is generated by the FSP Configuration editor and is used to generate threads if an RTOS is used.  This function
 * is called by main() when no RTOS is used.
 **********************************************************************************************************************/
void hal_entry (void)
{
    R_IOPORT_PinCfg(&g_ioport_ctrl,
                    BSP_IO_PORT_16_PIN_3,
                    ((uint32_t) IOPORT_CFG_DRIVE_HIGH | (uint32_t) IOPORT_CFG_PORT_PERI |
                     (uint32_t) IOPORT_CFG_REGION_NSAFETY | (uint32_t) IOPORT_CFG_SLEW_RATE_FAST |
                     (uint32_t) IOPORT_PIN_P163_PFC_14_RXD5_SCL5_MISO5));
    R_IOPORT_PinCfg(&g_ioport_ctrl,
                    BSP_IO_PORT_16_PIN_4,
                    ((uint32_t) IOPORT_CFG_DRIVE_HIGH | (uint32_t) IOPORT_CFG_PORT_PERI |
                     (uint32_t) IOPORT_CFG_REGION_NSAFETY | (uint32_t) IOPORT_CFG_SLEW_RATE_FAST |
                     (uint32_t) IOPORT_PIN_P164_PFC_14_TXD5_SDA5_MOSI5));

    unsigned long         proc_id = 0;
    unsigned long         rsc_id  = 0;
    struct rpmsg_device * rpdev;
    void                * platform;
    int ret;

    LPRINTF("****************  CA55_2 Baremetal  ******************\n", 0);
    LPRINTF("*****************************************************\n");

    ret = init_system();
    if (ret)
    {
        LPERROR("Failed to init remoteproc device.\n");
        goto err1;
    }

    ret = platform_init(proc_id, rsc_id, &platform);
    if (ret)
    {
        LPERROR("Failed to create remoteproc device.\n");
        goto err1;
    }
    else
    {
        do
        {
            /* RTOS is Master, but this setting must remote in this release. */
            rpdev = platform_create_rpmsg_vdev(platform, 0x0U, VIRTIO_DEV_SLAVE, NULL, NULL);
            if (!rpdev)
            {
                LPERROR("Fail, platform_create_rpmsg_vdev.\n");
                metal_log(METAL_LOG_INFO, "Fail, platform_create_rpmsg_vdev.");
                goto err2;
            }

            g_icu_inter_cpu_irq0.p_api->generate(g_icu_inter_cpu_irq0.p_ctrl);

            /* Kick the application */
            (void) app(rpdev, platform, proc_id);

            LPRINTF("De-initializating remoteproc\n");
            platform_release_rpmsg_vdev(platform, rpdev);

            R_BSP_SoftwareDelay(RECONNECT_DLY, BSP_DELAY_UNITS_MICROSECONDS);
        } while (RECONNECT_FLG);
    }

    platform_cleanup(platform);
    cleanup_system();

    /* Closes the icu_inter_cpu_irq */
    g_icu_inter_cpu_irq0.p_api->close(g_icu_inter_cpu_irq0.p_ctrl);
    g_icu_inter_cpu_irq1.p_api->close(g_icu_inter_cpu_irq1.p_ctrl);
err2:
    platform_cleanup(platform);
err1:
    while (1)
    {
        ;
    }
}

/*******************************************************************************************************************//**
 * This function is called at various points during the startup process.  This implementation uses the event that is
 * called right before main() to set up the pins.
 *
 * @param[in]  event    Where at in the start up process the code is currently at
 **********************************************************************************************************************/
void R_BSP_WarmStart (bsp_warm_start_event_t event)
{
    if (BSP_WARM_START_RESET == event)
    {
        /* Pre clock initialization */
    }

    if (BSP_WARM_START_POST_C == event)
    {
        /* C runtime environment and system clocks are setup. */

#if BSP_FEATURE_DDR_SUPPORTED
 #if (1 == BSP_CFG_DDR_INIT_ENABLE)

        /* Initialize the DDR settings. */
        bsp_ddr_init();
 #endif
#endif

        if (NULL != g_bsp_pin_cfg.p_extend)
        {
            /* Configure pins. */

            // R_IOPORT_Open (&IOPORT_CFG_CTRL, &IOPORT_CFG_NAME);
        }
    }
}

/*******************************************************************************************************************//**
 * This function is called without a stack at the very beginning of the startup process.
 * All instructions must be written in inline assembly.
 **********************************************************************************************************************/
BSP_ATTRIBUTE_STACKLESS void R_BSP_WarmStart_StackLess (void)
{
    /* The very beginning of the startup process. */

    /* Do not delete. Required to return to system_init. */
#if (0 == BSP_LP64_SUPPORT)
    __asm volatile ("BX lr");
#else
    __asm volatile ("BR lr");
#endif
}
