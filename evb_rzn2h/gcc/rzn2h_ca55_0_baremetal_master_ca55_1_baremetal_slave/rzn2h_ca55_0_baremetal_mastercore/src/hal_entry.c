#include "hal_data.h"
#include "RM_OpenAMP_App/rm_openamp_app.h"
#include "RM_OpenAMP_App/platform_info.h"
#include "RM_OpenAMP_App/rsc_table.h"
#include "openamp/open_amp.h"
#include "openamp/virtio.h"
#include "string.h"

FSP_CPP_HEADER
void R_BSP_WarmStart(bsp_warm_start_event_t event)
BSP_PLACE_IN_SECTION(".warm_start");
BSP_ATTRIBUTE_STACKLESS void R_BSP_WarmStart_StackLess(void)
BSP_PLACE_IN_SECTION(".warm_start");
FSP_CPP_FOOTER

#define IOPORT_CFG_NAME1    g_bsp_pin_cfg1

extern const ioport_cfg_t IOPORT_CFG_NAME1;

/***********************************************************************************************************************
 * Global Variables
 **********************************************************************************************************************/
static rm_openamp_options_t option;
char led_on[8]  = "43210C01";
char led_off[8] = "43210C00";
char rx_data[8];

extern uart_event_t g_uart_callback_event;

/***********************************************************************************************************************
 * Private function prototypes
 **********************************************************************************************************************/
uint8_t string_cmp(char * data0, char * data1, uint8_t len);

/*******************************************************************************************************************//**
 * main() is generated by the FSP Configuration editor and is used to generate threads if an RTOS is used.  This function
 * is called by main() when no RTOS is used.
 **********************************************************************************************************************/
void hal_entry (void)
{
    static uint32_t pre_led  = 0;
    uint32_t        ledstate = 0;
    uint32_t        led_send = 0;

    /* Open OpenAMP */
    (void) RM_OpenAMP_Open(VIRTIO_DEV_MASTER, 0, 0);

    /* Initialize the buffer data of UART */
    R_SCI_UART_Read(&g_uart0_ctrl, (uint8_t *) rx_data, 8);

    while (1)
    {
        if (stateOpenAMP_led == OPENAMP_STATE_CALLBACK_LED)
        {
            option = OPENAMP_OP_LED;
            RM_OpenAMP_Read(&option, &led_send);

            if (led_send != pre_led)
            {
                pre_led = led_send;
                if (led_send == 0)
                {
                    LPRINTF("SLave turned off LED\n");
                }
                else if (led_send == 1)
                {
                    LPRINTF("Slave turned on LED\n");
                }
            }
        }

        /* Check event uart RX completing */
        if (g_uart_callback_event == 1)
        {
            LPRINTF("Received data from UART\n");
            if (string_cmp(rx_data, led_on, 8) == 0)
            {
                ledstate = 1;
            }
            else if (string_cmp(rx_data, led_off, 8) == 0)
            {
                ledstate = 0;
            }
            else
            {
                /* Nothing to do */
            }

            /* Check previous led with led from slave */
            if (ledstate != led_send)
            {
                option = OPENAMP_OP_LED;
                RM_OpenAMP_Write(&option, &ledstate);
            }
            else
            {
                /* Nothing to do */
            }

            /* Re-initialize for new buffer data of UART */
            R_SCI_UART_Read(&g_uart0_ctrl, (uint8_t *) rx_data, 8);
            g_uart_callback_event = 0;
        }
        else
        {
            /* Nothing to do */
        }
    }
}

/**
 * This function is to compare two strings with length.
 *
 * @param[in] string array data0.
 * @param[in] string array data1.
 * @param[in] length of string comparing.
 * @return return 0/1 (Equal/NotEqual).
 */
uint8_t string_cmp (char * data0, char * data1, uint8_t len)
{
    for (uint8_t index = 0; index < len; index++)
    {
        if (data0[index] != data1[index])
        {
            return 1;
        }
    }

    return 0;
}

/*******************************************************************************************************************//**
 * This function is called at various points during the startup process.  This implementation uses the event that is
 * called right before main() to set up the pins.
 *
 * @param[in]  event    Where at in the start up process the code is currently at
 **********************************************************************************************************************/
void R_BSP_WarmStart (bsp_warm_start_event_t event)
{
    if (BSP_WARM_START_RESET == event)
    {
        /* Pre clock initialization */
    }

    if (BSP_WARM_START_POST_C == event)
    {
        /* C runtime environment and system clocks are setup. */

#if BSP_FEATURE_DDR_SUPPORTED
 #if (1 == BSP_CFG_DDR_INIT_ENABLE)

        /* Initialize the DDR settings. */
        bsp_ddr_init();
        R_BSP_CacheInvalidateAll();
 #endif
#endif

        if (NULL != g_bsp_pin_cfg1.p_extend)
        {
            /* Configure pins. */
            R_IOPORT_Open(&IOPORT_CFG_CTRL, &IOPORT_CFG_NAME1);
        }
    }
}

/*******************************************************************************************************************//**
 * This function is called without a stack at the very beginning of the startup process.
 * All instructions must be written in inline assembly.
 **********************************************************************************************************************/
BSP_ATTRIBUTE_STACKLESS void R_BSP_WarmStart_StackLess(void)
{
    /* The very beginning of the startup process. */

    /* Do not delete. Required to return to system_init. */
#if (0 == BSP_LP64_SUPPORT)
    __asm volatile ("BX lr");
#else
    __asm volatile ("BR lr");
#endif
}
