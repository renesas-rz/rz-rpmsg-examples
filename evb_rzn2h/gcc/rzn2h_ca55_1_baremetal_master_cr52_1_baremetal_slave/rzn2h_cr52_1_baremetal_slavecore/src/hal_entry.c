#include "hal_data.h"
#include "RM_OpenAMP_App/rm_openamp_app.h"
#include "RM_OpenAMP_App/platform_info.h"
#include "RM_OpenAMP_App/rsc_table.h"
#include "openamp/open_amp.h"
#include "openamp/virtio.h"
#include "string.h"

FSP_CPP_HEADER
void R_BSP_WarmStart(bsp_warm_start_event_t event)
BSP_PLACE_IN_SECTION(".warm_start");
BSP_ATTRIBUTE_STACKLESS void R_BSP_WarmStart_StackLess(void)
BSP_PLACE_IN_SECTION(".warm_start");
FSP_CPP_FOOTER

#define IOPORT_CFG_NAME1    g_bsp_pin_cfg1

extern const ioport_cfg_t IOPORT_CFG_NAME1;

/***********************************************************************************************************************
 * Private function prototypes
 **********************************************************************************************************************/
static void verify_led_from_master(void);

/*******************************************************************************************************************//**
 * main() is generated by the FSP Configuration editor and is used to generate threads if an RTOS is used.  This function
 * is called by main() when no RTOS is used.
 **********************************************************************************************************************/
void hal_entry (void)
{
    /* Open OpenAMP */
    (void) RM_OpenAMP_Open(VIRTIO_DEV_SLAVE, 0, 0);

    while (1)
    {
        if (stateOpenAMP_led == OPENAMP_STATE_CALLBACK_LED)
        {
            verify_led_from_master();
        }
        else
        {
            /* Nothing to do */
        }
    }
}

/**
 * This function is to confirm the led returned from the master.
 *
 * @param[in] This function has no input parameters.
 * @return No return value.
 */
static void verify_led_from_master (void)
{
    uint32_t             led_master;
    uint32_t             led_slave;
    rm_openamp_options_t option_master = OPENAMP_OP_LED;

    RM_OpenAMP_Read(&option_master, &led_master);

    if (led_master == 1)
    {
        R_IOPORT_PinWrite(&g_ioport_ctrl, BSP_IO_PORT_14_PIN_6, BSP_IO_LEVEL_HIGH);
        led_slave = 1;
    }
    else if (led_master == 0)
    {
        R_IOPORT_PinWrite(&g_ioport_ctrl, BSP_IO_PORT_14_PIN_6, BSP_IO_LEVEL_LOW);
        led_slave = 0;
    }
    else
    {
        /* Nothing to do */
    }

    (void) RM_OpenAMP_Write(&option_master, &led_slave);
}

/*******************************************************************************************************************//**
 * This function is called at various points during the startup process.  This implementation uses the event that is
 * called right before main() to set up the pins.
 *
 * @param[in]  event    Where at in the start up process the code is currently at
 **********************************************************************************************************************/
void R_BSP_WarmStart (bsp_warm_start_event_t event)
{
    if (BSP_WARM_START_RESET == event)
    {
        /* Pre clock initialization */
    }

    if (BSP_WARM_START_POST_C == event)
    {
        /* C runtime environment and system clocks are setup. */

#if BSP_FEATURE_DDR_SUPPORTED
 #if (1 == BSP_CFG_DDR_INIT_ENABLE)

        /* Initialize the DDR settings. */
        bsp_ddr_init();
        R_BSP_CacheInvalidateAll();
 #endif
#endif

        if (NULL != g_bsp_pin_cfg1.p_extend)
        {
            /* Configure pins. */
            R_IOPORT_Open(&IOPORT_CFG_CTRL, &IOPORT_CFG_NAME1);
        }
    }
}

/*******************************************************************************************************************//**
 * This function is called without a stack at the very beginning of the startup process.
 * All instructions must be written in inline assembly.
 **********************************************************************************************************************/
BSP_ATTRIBUTE_STACKLESS void R_BSP_WarmStart_StackLess(void)
{
    /* The very beginning of the startup process. */

    /* Do not delete. Required to return to system_init. */
#if (0 == BSP_LP64_SUPPORT)
    __asm volatile ("BX lr");
#else
    __asm volatile ("BR lr");
#endif
}
